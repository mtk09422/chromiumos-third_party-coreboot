## src/arch/arm/Kconfig
```kconfig
menu "Architecture (arm)"

config ARCH_BOOTBLOCK_ARM
	bool
	default n
	select ARCH_ARM

config ARCH_ROMSTAGE_ARM
	bool
	default n

config ARCH_RAMSTAGE_ARM
	bool
	default n

source src/arch/arm/armv4/Kconfig
source src/arch/arm/armv7/Kconfig

# If a custom bootblock is necessary, this option should be "select"-ed by
# the thing that needs it, probably the CPU.
config ARM_BOOTBLOCK_CUSTOM
	bool
	default n

choice
	prompt "Bootblock behaviour"
	default ARM_BOOTBLOCK_SIMPLE
	depends on !ARM_BOOTBLOCK_CUSTOM

config ARM_BOOTBLOCK_SIMPLE
	bool "Always load fallback"

config ARM_BOOTBLOCK_NORMAL
	bool "Switch to normal if non-volatile memory says so"

endchoice

config CBMEM_CONSOLE_PRERAM_BASE
	hex
	depends on CONSOLE_CBMEM

config CPU_HAS_BOOTBLOCK_INIT
	bool
	default n

config MAINBOARD_HAS_BOOTBLOCK_INIT
	bool
	default n

config UPDATE_IMAGE
	bool "Update existing coreboot.rom image"
	default n
	help
	  If this option is enabled, no new coreboot.rom file
	  is created. Instead it is expected that there already
	  is a suitable file for further processing.
	  The bootblock will not be modified.

config ARM_LPAE
	bool "Enable LPAE"
	default n

endmenu
```

## src/arch/arm/armv4/Kconfig
```kconfig
config ARM_BOOTBLOCK_ARMV4
	def_bool n
config ARM_ROMSTAGE_ARMV4
	def_bool n
config ARM_RAMSTAGE_ARMV4
	def_bool n
```

## src/arch/arm/armv7/Kconfig
```kconfig
config ARCH_BOOTBLOCK_ARM_V7
	def_bool n
	select ARCH_BOOTBLOCK_ARM
config ARCH_VERSTAGE_ARM_V7
	def_bool n
	select ARCH_VERSTAGE_ARM
config ARCH_ROMSTAGE_ARM_V7
	def_bool n
	select ARCH_ROMSTAGE_ARM
config ARCH_RAMSTAGE_ARM_V7
	def_bool n
	select ARCH_RAMSTAGE_ARM
config ARCH_BOOTBLOCK_ARM_V7_M
	def_bool n
	select ARCH_BOOTBLOCK_ARM
config ARCH_VERSTAGE_ARM_V7_M
	def_bool n
	select ARCH_VERSTAGE_ARM
```

## src/arch/armv7/Kconfig
```kconfig
menu "Architecture (armv7)"


config ARM_ARCH_OPTIONS
	bool
	default y
	select HAVE_ARCH_MEMSET
	select HAVE_ARCH_MEMCPY
	select HAVE_ARCH_MEMMOVE

# Maximum reboot count
# TODO: Improve description.
config MAX_REBOOT_CNT
	int
	default 3

# If a custom bootblock is necessary, this option should be "select"-ed by
# the thing that needs it, probably the CPU.
config ARM_BOOTBLOCK_CUSTOM
	bool
	default n

choice
	prompt "Bootblock behaviour"
	default ARM_BOOTBLOCK_SIMPLE
	depends on !ARM_BOOTBLOCK_CUSTOM

config ARM_BOOTBLOCK_SIMPLE
	bool "Always load fallback"

config ARM_BOOTBLOCK_NORMAL
	bool "Switch to normal if non-volatile memory says so"

endchoice

config CPU_HAS_BOOTBLOCK_INIT
	bool
	default n

config MAINBOARD_HAS_BOOTBLOCK_INIT
	bool
	default n

config UPDATE_IMAGE
	bool "Update existing coreboot.rom image"
	default n
	help
	  If this option is enabled, no new coreboot.rom file
	  is created. Instead it is expected that there already
	  is a suitable file for further processing.
	  The bootblock will not be modified.

endmenu
```

## src/cpu/armltd/armv8/Kconfig
```kconfig
config CPU_ARMLTD_ARMV8
	bool
	select ARCH_AARCH64
	select EARLY_CONSOLE
	default n

if CPU_ARMLTD_ARMV8

endif
```

## src/cpu/armltd/cortex-a9/Kconfig
```kconfig
config CPU_ARMLTD_CORTEX_A9
	bool
	select ARCH_BOOTBLOCK_ARM_V7
	select ARCH_ROMSTAGE_ARM_V7
	select ARCH_RAMSTAGE_ARM_V7
	select EARLY_CONSOLE
	default n

if CPU_ARMLTD_CORTEX_A9

endif
```

## src/drivers/pc80/Kconfig
```kconfig
# Might be removed (alongside with the PS/2 init code) once payloads
# reliably support PS/2 init themselves.
config DRIVERS_PS2_KEYBOARD
	bool "PS/2 keyboard init"
	default y
	help
	  Enable this option to initialize PS/2 keyboards found connected
	  to the PS/2 port.

	  Some payloads (eg, filo) require this option.  Other payloads
	  (eg, SeaBIOS, Linux) do not require it.
	  Initializing a PS/2 keyboard can take several hundred milliseconds.

	  If you know you will only use a payload which does not require
	  this option, then you can say N here to speed up boot time.
	  Otherwise say Y.

config DRIVERS_MC146818_RTC
	bool
	default y if ARCH_X86
	default n if !ARCH_X86

config DRIVERS_MC146818_CMOS
	bool
	default y if ARCH_X86
	default n if !ARCH_X86

config DRIVERS_RTC_HAS_ALTCENTURY
	bool "The RTC supports alt century"
	depends on DRIVERS_MC146818_RTC
	default y

source src/drivers/pc80/tpm/Kconfig
```

## src/mainboard/emulation/foundation-armv8/Kconfig
```kconfig
##
## This file is part of the coreboot project.
##
## Copyright (C) 2013 Google Inc.
##
## This software is licensed under the terms of the GNU General Public
## License version 2, as published by the Free Software Foundation, and
## may be copied, distributed, and modified under those terms.
##
## This program is distributed in the hope that it will be useful,
## but WITHOUT ANY WARRANTY; without even the implied warranty of
## MERCHANTABILITY or FITNESS FOR A PARTICULAR PURPOSE.  See the
## GNU General Public License for more details.

# To execute, do:
# ./Foundation_v8 --cores=1 --no-secure-memory --visualization \
# --gicv3 --data=build/coreboot.rom@0x0

if BOARD_EMULATION_FOUNDATION_ARMV8

config BOARD_SPECIFIC_OPTIONS # dummy
	def_bool y
	select CPU_ARMLTD_ARMV8
	select HAVE_UART_MEMORY_MAPPED
	select HAVE_UART_SPECIAL
	select BOARD_ROMSIZE_KB_4096
	select DYNAMIC_CBMEM

config MAINBOARD_DIR
	string
	default emulation/foundation-armv8

config MAINBOARD_PART_NUMBER
	string
	default "FOUNDATION ARMV8"

config MAX_CPUS
	int
	default 1

config MAINBOARD_VENDOR
	string
	default "ARM Ltd."

config BOOTBLOCK_MAINBOARD_INIT
	string
	default "mainboard/emulation/foundation-armv8/bootblock.c"

config DRAM_SIZE_MB
	int
	default 1024

config BOOTBLOCK_ROM_OFFSET
	hex
	default 0x0

config CBFS_HEADER_ROM_OFFSET
	hex
	default 0x0100000

config CBFS_ROM_OFFSET
	hex
	default 0x0110000

endif #  BOARD_EMULATION_FOUNDATION_ARMV8
```

## src/mainboard/emulation/qemu-armv7/Kconfig
```kconfig
##
## This file is part of the coreboot project.
##
## Copyright 2014 Google Inc.
##
## This software is licensed under the terms of the GNU General Public
## License version 2, as published by the Free Software Foundation, and
## may be copied, distributed, and modified under those terms.
##
## This program is distributed in the hope that it will be useful,
## but WITHOUT ANY WARRANTY; without even the implied warranty of
## MERCHANTABILITY or FITNESS FOR A PARTICULAR PURPOSE.  See the
## GNU General Public License for more details.

# Emulation for ARM Ltd Versatile Express Cortex-A9
#  http://www.arm.com/products/tools/development-boards/versatile-express

# To execute, do:
# export QEMU_AUDIO_DRV=none
# qemu-system-arm -M vexpress-a9 -m 1024M -nographic -kernel build/coreboot.rom

if BOARD_EMULATION_QEMU_ARMV7

config BOARD_SPECIFIC_OPTIONS # dummy
	def_bool y
	select CPU_ARMLTD_CORTEX_A9
	select HAVE_UART_MEMORY_MAPPED
	select HAVE_UART_SPECIAL
	select BOOTBLOCK_CONSOLE
	select EARLY_CONSOLE
	select CONSOLE_SERIAL
	select ARCH_BOOTBLOCK_ARM_V7
	select ARCH_ROMSTAGE_ARM_V7
	select ARCH_RAMSTAGE_ARM_V7
	select BOARD_ROMSIZE_KB_4096

config MAINBOARD_DIR
	string
	default emulation/qemu-armv7

config MAINBOARD_PART_NUMBER
	string
	default "QEMU ARMv7"

config MAX_CPUS
	int
	default 2

config MAINBOARD_VENDOR
	string
	default "ARM Ltd."

config DRAM_SIZE_MB
	int
	default 1024

endif #  BOARD_EMULATION_QEMU_ARMV7
```

## src/mainboard/gizmosphere/Kconfig
```kconfig
if VENDOR_GIZMOSPHERE

choice
	prompt "Mainboard model"

config BOARD_GIZMOSPHERE_GIZMO
	bool "Gizmo"

endchoice

source "src/mainboard/gizmosphere/gizmo/Kconfig"
config MAINBOARD_VENDOR
	string
	default "GizmoSphere"

endif # VENDOR_GIZMOSPHERE
```

## src/mainboard/google/Kconfig
```kconfig
##
## This file is part of the coreboot project.
##
## Copyright (C) 2012 The ChromiumOS Authors
##
## This program is free software; you can redistribute it and/or modify
## it under the terms of the GNU General Public License as published by
## the Free Software Foundation; version 2 of the License.
##
## This program is distributed in the hope that it will be useful,
## but WITHOUT ANY WARRANTY; without even the implied warranty of
## MERCHANTABILITY or FITNESS FOR A PARTICULAR PURPOSE.  See the
## GNU General Public License for more details.
##
## You should have received a copy of the GNU General Public License
## along with this program; if not, write to the Free Software
## Foundation, Inc., 51 Franklin St, Fifth Floor, Boston, MA 02110-1301 USA
##
if VENDOR_GOOGLE

# Auto select common options
config VENDOR_SPECIFIC_OPTIONS
	def_bool y
	select CACHE_ROM

choice
	prompt "Mainboard model"

config BOARD_GOOGLE_AURON
	bool "Auron"
	help
	  Google Auron mainboard.
	  Enable this config to select the Google Auron mainboard.
	  Auron is a Chrome OS mainboard.
	  Auron is based on the Intel Broadwell platform.
config BOARD_GOOGLE_BELTINO
	bool "Beltino"
	help
	  Google Beltino mainboard.
	  Enable this config to select the Google Beltino mainboard.
	  Beltino is a Chrome OS mainboard.
	  Beltino is based on the Intel Haswell platform.
config BOARD_GOOGLE_BOLT
	bool "Bolt"
	help
	  Google Bolt mainboard.
	  Enable this config to select the Google Bolt mainboard.
	  Bolt is a Chrome OS mainboard.
	  Bolt is based on the Intel Haswell platform.
config BOARD_GOOGLE_BUTTERFLY
	bool "Butterfly"
	help
	  Google Butterfly mainboard.
	  Enable this config to select the Google Butterfly mainboard.
	  Butterfly is a Chrome OS mainboard.
	  Butterfly is based on the Intel Sandy Bridge platform.
config BOARD_GOOGLE_DAISY
	bool "Daisy"
	help
	  Google Daisy mainboard.
	  Enable this config to select the Google Daisy mainboard.
	  Daisy is a Chrome OS mainboard.
	  Daisy is based on the Samsung Exynos 5250 platform.
config BOARD_GOOGLE_FALCO
	bool "Falco"
	help
	  Google Falco mainboard.
	  Enable this config to select the Google Falco mainboard.
	  Falco is a Chrome OS mainboard.
	  Falco is based on the Intel Haswell platform.
config BOARD_GOOGLE_LINK
	bool "Link"
	help
	  Google Link mainboard.
	  Enable this config to select the Google Link mainboard.
	  Link is a Chrome OS mainboard.
	  Link is based on the Intel Ivy Bridge platform.
config BOARD_GOOGLE_NYAN
	bool "Nyan"
	help
	  Google Nyan mainboard.
	  Enable this config to select the Google Nyan mainboard.
	  Nyan is a Chrome OS mainboard.
	  Nyan is based on the Nvidia Tegra 124 platform.
config BOARD_GOOGLE_NYAN_BIG
	bool "Nyan Big"
	help
	  Google Nyan Big mainboard.
	  Enable this config to select the Google Nyan Big mainboard.
	  Nyan Big is a Chrome OS mainboard.
	  Nyan Big is based on the Nvidia Tegra 124 platform.
config BOARD_GOOGLE_NYAN_BLAZE
	bool "Nyan Blaze"
	help
	  Google Nyan Blaze mainboard.
	  Enable this config to select the Google Nyan Blaze mainboard.
	  Nyan Blaze is a Chrome OS mainboard.
	  Nyan Blaze is based on the Nvidia Tegra 124 platform.
config BOARD_GOOGLE_PANTHER
	bool "Panther"
	help
	  Google Panther mainboard.
	  Enable this config to select the Google Panther mainboard.
	  Panther is a Chrome OS mainboard.
	  Panther is based on the Intel Haswell platform.
config BOARD_GOOGLE_PARROT
	bool "Parrot"
	help
	  Google Parrot mainboard.
	  Enable this config to select the Google Parrot mainboard.
	  Parrot is a Chrome OS mainboard.
	  Parrot is based on the Intel Ivy Bridge platform.
config BOARD_GOOGLE_PEACH_PIT
	bool "Peach Pit"
	help
	  Google Peach Pit mainboard.
	  Enable this config to select the Google Peach Pit mainboard.
	  Peach Pit is a Chrome OS mainboard.
	  Peach Pit is based on the Samsung Exynos 5420 platform.
config BOARD_GOOGLE_PEPPY
	bool "Peppy"
	help
	  Google Peppy mainboard.
	  Enable this config to select the Google Peppy mainboard.
	  Peppy is a Chrome OS mainboard.
	  Peppy is based on the Intel Haswell platform.
config BOARD_GOOGLE_RAMBI
	bool "Rambi"
	help
	  Google Rambi mainboard.
	  Enable this config to select the Google Rambi mainboard.
	  Rambi is a Chrome OS mainboard.
	  Rambi is based on the Intel Baytrail platform.
config BOARD_GOOGLE_RUSH
	bool "Rush"
	help
	  Google Rush mainboard.
	  Enable this config to select the Google Rush mainboard.
	  Rush is a Chrome OS mainboard.
	  Rush is based on the Nvidia Tegra 132 platform.
config BOARD_GOOGLE_RUSH_RYU
	bool "Rush Ryu"
	help
	  Google Ryu mainboard.
	  Enable this config to select the Google Ryu mainboard.
	  Ryu is a Chrome OS mainboard.
	  Ryu is based on the Nvidia Tegra 132 platform.
config BOARD_GOOGLE_SAMUS
	bool "Samus"
	help
	  Google Saums mainboard.
	  Enable this config to select the Google Samus mainboard.
	  Samus is a Chrome OS mainboard.
	  Samus is based on the Intel Broadwell platform.
config BOARD_GOOGLE_SLIPPY
	bool "Slippy"
	help
	  Google Slippy mainboard.
	  Enable this config to select the Google Slippy mainboard.
	  Slippy is a Chrome OS mainboard.
	  Slippy is based on the Intel Haswell platform.
config BOARD_GOOGLE_STORM
	bool "Storm"
	help
	  Google Storm mainboard.
	  Enable this config to select the Google Storm mainboard.
	  Storm is a Chrome OS mainboard.
	  Storm is based on the Qualcomm IPQ806X platform.
config BOARD_GOOGLE_STOUT
	bool "Stout"
	help
	  Google Stout mainboard.
	  Enable this config to select the Google Stout mainboard.
	  Stout is a Chrome OS mainboard.
	  Stout is based on the Intel Ivy Bridge platform.
config BOARD_GOOGLE_VEYRON
	bool "Veyron"
	help
	  Google Veyron mainboard.
	  Enable this config to select the Google Veyron mainboard.
	  Veyron is a Chrome OS mainboard.
	  Veyron is based on the Rockchip RK3288 platform.

endchoice

source "src/mainboard/google/auron/Kconfig"
source "src/mainboard/google/beltino/Kconfig"
source "src/mainboard/google/bolt/Kconfig"
source "src/mainboard/google/butterfly/Kconfig"
source "src/mainboard/google/daisy/Kconfig"
source "src/mainboard/google/falco/Kconfig"
source "src/mainboard/google/link/Kconfig"
source "src/mainboard/google/nyan/Kconfig"
source "src/mainboard/google/nyan_big/Kconfig"
source "src/mainboard/google/nyan_blaze/Kconfig"
source "src/mainboard/google/panther/Kconfig"
source "src/mainboard/google/parrot/Kconfig"
source "src/mainboard/google/peach_pit/Kconfig"
source "src/mainboard/google/peppy/Kconfig"
source "src/mainboard/google/rambi/Kconfig"
source "src/mainboard/google/rush/Kconfig"
source "src/mainboard/google/rush_ryu/Kconfig"
source "src/mainboard/google/samus/Kconfig"
source "src/mainboard/google/slippy/Kconfig"
source "src/mainboard/google/storm/Kconfig"
source "src/mainboard/google/stout/Kconfig"
source "src/mainboard/google/veyron/Kconfig"

config MAINBOARD_VENDOR
	string "Mainboard Vendor"
	default "GOOGLE"

endif # VENDOR_GOOGLE
```

## src/mainboard/google/cyan/Kconfig
```kconfig
if BOARD_GOOGLE_CYAN

config BOARD_SPECIFIC_OPTIONS
	def_bool y
	select BOARD_ROMSIZE_KB_8192
	select CHROMEOS
	select ENABLE_BUILTIN_COM1
	select SOC_INTEL_BRASWELL

config DISPLAY_SPD_DATA
	bool "Display Memory Serial Presence Detect Data"
	default n
	help
	  When enabled displays the memory SPD data.

config DYNAMIC_VNN_SUPPORT
	bool "Enables support for Dynamic VNN"
	default n

config MAINBOARD_DIR
	string
	default google/cyan

config MAINBOARD_PART_NUMBER
	string
	default "Cyan"

if !CONFIG_GOP_SUPPORT
config VGA_BIOS_FILE
	string
	default "3rdparty/mainboard/intel/strago/vgabios_c0.bin" if C0_DISP_SUPPORT
	default "3rdparty/mainboard/intel/strago/vgabios.bin" if !C0_DISP_SUPPORT

config VGA_BIOS_ID
	string
	default "8086,22b1" if C0_DISP_SUPPORT
	default "8086,22b0" if !C0_DISP_SUPPORT
endif

endif # BOARD_GOOGLE_CYAN
```
