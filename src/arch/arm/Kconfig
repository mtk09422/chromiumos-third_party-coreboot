## src/mainboard/google/jecht/Kconfig
```kconfig
if BOARD_GOOGLE_JECHT

config BOARD_SPECIFIC_OPTIONS # dummy
	def_bool y
	select SOC_INTEL_BROADWELL
	select BOARD_ROMSIZE_KB_8192
	select SUPERIO_ITE_IT8772F
	select VIRTUAL_DEV_SWITCH
	select HAVE_ACPI_TABLES
	select HAVE_OPTION_TABLE
	select HAVE_ACPI_RESUME
	select MMCONF_SUPPORT
	select HAVE_SMI_HANDLER
	select CHROMEOS
	select CHROMEOS_VBNV_CMOS
	select EXTERNAL_MRC_BLOB
	select CACHE_ROM
	select MARK_GRAPHICS_MEM_WRCOMB
	select MONOTONIC_TIMER_MSR
	select CHROMEOS_RAMOOPS_DYNAMIC
	select PHYSICAL_REC_SWITCH

config VBOOT_RAMSTAGE_INDEX
	hex
	default 0x1

config VBOOT_REFCODE_INDEX
	hex
	default 0x2

config MAINBOARD_DIR
	string
	default google/jecht

config MAINBOARD_PART_NUMBER
	string
	default "Jecht"

config IRQ_SLOT_COUNT
	int
	default 18

config MAX_CPUS
	int
	default 8

config VGA_BIOS_FILE
	string
	default "pci8086,0166.rom"

config MAINBOARD_FAMILY
	string
	depends on GENERATE_SMBIOS_TABLES
	default "Google_Jecht"

endif
```

## src/mainboard/google/llama/Kconfig
```kconfig
##
## This file is part of the coreboot project.
##
## Copyright 2014 Google Inc.
##
## This program is free software; you can redistribute it and/or modify
## it under the terms of the GNU General Public License as published by
## the Free Software Foundation; version 2 of the License.
##
## This program is distributed in the hope that it will be useful,
## but WITHOUT ANY WARRANTY; without even the implied warranty of
## MERCHANTABILITY or FITNESS FOR A PARTICULAR PURPOSE.  See the
## GNU General Public License for more details.
##
## You should have received a copy of the GNU General Public License
## along with this program; if not, write to the Free Software
## Foundation, Inc., 51 Franklin St, Fifth Floor, Boston, MA 02110-1301 USA
##

if BOARD_GOOGLE_LLAMA

config BOARD_SPECIFIC_OPTIONS
	def_bool y
	select MAINBOARD_HAS_BOOTBLOCK_INIT
	select SOC_MEDIATEK_MT8135
	select CHROMEOS
	select CHROMEOS_VBNV_EC
	select EC_GOOGLE_CHROMEEC
	select EC_GOOGLE_CHROMEEC_SPI

config MAINBOARD_DIR
	string
	default google/llama

config MAINBOARD_PART_NUMBER
	string
	default "MT8135_P1V2" if BOARD_VARIANT_AP148
	default "llama"

config DRAM_SIZE_MB
	int
	default 1024

config EC_GOOGLE_CHROMEEC_SPI_BUS
	hex
	default 0

endif # BOARD_GOOGLE_LLAMA
```

## src/mainboard/google/oak/Kconfig
```kconfig
##
## This file is part of the coreboot project.
##
## Copyright 2014 Google Inc.
##
## This program is free software; you can redistribute it and/or modify
## it under the terms of the GNU General Public License as published by
## the Free Software Foundation; version 2 of the License.
##
## This program is distributed in the hope that it will be useful,
## but WITHOUT ANY WARRANTY; without even the implied warranty of
## MERCHANTABILITY or FITNESS FOR A PARTICULAR PURPOSE.  See the
## GNU General Public License for more details.
##
## You should have received a copy of the GNU General Public License
## along with this program; if not, write to the Free Software
## Foundation, Inc., 51 Franklin St, Fifth Floor, Boston, MA 02110-1301 USA
##

if BOARD_GOOGLE_OAK

config BOARD_SPECIFIC_OPTIONS
	def_bool y
	select SOC_MEDIATEK_MT8173
	select CHROMEOS
	select CHROMEOS_VBNV_EC
	select EC_GOOGLE_CHROMEEC
	select EC_GOOGLE_CHROMEEC_SPI
	select VIRTUAL_DEV_SWITCH

config BOOTBLOCK_MAINBOARD_INIT
	string
	default "mainboard/google/oak/bootblock.c"

config MAINBOARD_DIR
	string
	default google/oak

config MAINBOARD_PART_NUMBER
	string
	default "oak"

config DRAM_SIZE_MB
	int
	default 2048

config EC_GOOGLE_CHROMEEC_SPI_BUS
	hex
	default 0

endif # BOARD_GOOGLE_OAK
```
