## src/soc/nvidia/tegra132/Kconfig
```kconfig
config SOC_NVIDIA_TEGRA132
	bool
	default n
	select ARCH_BOOTBLOCK_ARM_V4
	select ARCH_VERSTAGE_ARM_V4
	select ARCH_ROMSTAGE_ARM_V4
	select ARCH_RAMSTAGE_ARM_V8_64
	select BOOTBLOCK_CONSOLE
	select GIC
	select HAVE_MONOTONIC_TIMER
	select GENERIC_UDELAY
	select HAVE_HARD_RESET
	select HAVE_UART_SPECIAL
	select HAVE_UART_MEMORY_MAPPED
	select EARLY_CONSOLE
	select ARM_BOOTBLOCK_CUSTOM
	select DYNAMIC_CBMEM
	select SMP
	select ARCH_USE_SECURE_MONITOR

if SOC_NVIDIA_TEGRA132

config BOOTBLOCK_CPU_INIT
	string
	default "soc/nvidia/tegra132/bootblock.c"
	help
	  CPU/SoC-specific bootblock code. This is useful if the
	  bootblock must load microcode or copy data from ROM before
	  searching for the bootblock.

config BOOTBLOCK_ROM_OFFSET
	hex
	default 0x0

config MAX_CPUS
	int
	default 2

config CBFS_HEADER_ROM_OFFSET
	hex "offset of master CBFS header in ROM"
	default 0x22000

config CBFS_ROM_OFFSET
	hex "offset of CBFS data in ROM"
	default 0x22080

choice CONSOLE_SERIAL_TEGRA132_UART_CHOICES
	prompt "Serial Console UART"
	default CONSOLE_SERIAL_TEGRA132_UARTA
	depends on CONSOLE_SERIAL_UART

config CONSOLE_SERIAL_TEGRA132_UARTA
	bool "UARTA"
	help
	  Serial console on UART A.

config CONSOLE_SERIAL_TEGRA132_UARTB
	bool "UARTB"
	help
	  Serial console on UART B.

config CONSOLE_SERIAL_TEGRA132_UARTC
	bool "UARTC"
	help
	  Serial console on UART C.

config CONSOLE_SERIAL_TEGRA132_UARTD
	bool "UARTD"
	help
	  Serial console on UART D.

config CONSOLE_SERIAL_TEGRA132_UARTE
	bool "UARTE"
	help
	  Serial console on UART E.

endchoice

config CONSOLE_SERIAL_TEGRA132_UART_ADDRESS
	hex
	depends on CONSOLE_SERIAL_UART
	default 0x70006000 if CONSOLE_SERIAL_TEGRA132_UARTA
	default 0x70006040 if CONSOLE_SERIAL_TEGRA132_UARTB
	default 0x70006200 if CONSOLE_SERIAL_TEGRA132_UARTC
	default 0x70006300 if CONSOLE_SERIAL_TEGRA132_UARTD
	default 0x70006400 if CONSOLE_SERIAL_TEGRA132_UARTE
	help
	  Map the UART names to the respective MMIO addres.

config MTS_DIRECTORY
	string "Directory where MTS microcode files are located"
	default "."
	help
	  Path to directory where MTS microcode files are located.

config TRUSTZONE_CARVEOUT_SIZE_MB
	hex "Size of Trust Zone region"
	default 0x4
	help
	  Size of Trust Zone area in MiB to reserve in memory map.

config BOOTROM_SDRAM_INIT
	bool "SoC BootROM does SDRAM init with full BCT"
	default n
	help
	  Use during Ryu LPDDR3 bringup

# Default to 700MHz. This value is based on nv bootloader setting.
config PLLX_KHZ
	int
	default 700000
endif
```

## src/soc/qualcomm/ipq806x/Kconfig
```kconfig
config SOC_QC_IPQ806X
	bool
	default n
	select ARCH_BOOTBLOCK_ARM_V7
	select ARCH_RAMSTAGE_ARM_V7
	select ARCH_ROMSTAGE_ARM_V7
	select ARCH_VERSTAGE_ARM_V7
	select BOOTBLOCK_CONSOLE
	select DYNAMIC_CBMEM
	select EARLY_CONSOLE
	select HAVE_UART_MEMORY_MAPPED
	select HAVE_UART_SPECIAL
	select SPI_ATOMIC_SEQUENCING

if SOC_QC_IPQ806X

config MBN_ENCAPSULATION
	depends on USE_BLOBS
	bool "bootblock encapsulation for ipq8064"
	default y

config SBL_BLOB
	depends on USE_BLOBS
	string "file name of the Qualcomm SBL blob"
	default "3rdparty/cpu/qualcomm/ipq806x/uber-sbl.mbn"
	help
	  The path and filename of the binary blob containing
	  ipq806x early initialization code, as supplied by the
	  vendor.

endif
```

## src/soc/rockchip/rk3288/Kconfig
```kconfig
##
## This file is part of the coreboot project.
##
## Copyright 2014 Rockchip Inc.
##
## This program is free software; you can redistribute it and/or modify
## it under the terms of the GNU General Public License as published by
## the Free Software Foundation; version 2 of the License.
##
## This program is distributed in the hope that it will be useful,
## but WITHOUT ANY WARRANTY; without even the implied warranty of
## MERCHANTABILITY or FITNESS FOR A PARTICULAR PURPOSE.  See the
## GNU General Public License for more details.
##
## You should have received a copy of the GNU General Public License
## along with this program; if not, write to the Free Software
## Foundation, Inc., 51 Franklin St, Fifth Floor, Boston, MA 02110-1301 USA
##

config SOC_ROCKCHIP_RK3288
	bool
	default n
	select CPU_HAS_BOOTBLOCK_INIT
	select HAVE_MONOTONIC_TIMER
	select GENERIC_UDELAY
	select HAVE_UART_SPECIAL
	select EARLY_CONSOLE
	select DYNAMIC_CBMEM
	select ARCH_BOOTBLOCK_ARM_V7
	select ARCH_VERSTAGE_ARM_V7
	select ARCH_ROMSTAGE_ARM_V7
	select ARCH_RAMSTAGE_ARM_V7
	select HAVE_UART_MEMORY_MAPPED
	select BOOTBLOCK_CONSOLE
	select COLLECT_TIMESTAMPS
	select HAS_PRECBMEM_TIMESTAMP_REGION

if SOC_ROCKCHIP_RK3288

config BOOTBLOCK_CPU_INIT
	string
	default "soc/rockchip/rk3288/bootblock.c"

endif
```

## src/soc/samsung/exynos5250/Kconfig
```kconfig
config CPU_SAMSUNG_EXYNOS5250
	select CPU_HAS_BOOTBLOCK_INIT
	select HAVE_MONOTONIC_TIMER
	select GENERIC_UDELAY
	select HAVE_UART_SPECIAL
	select EARLY_CONSOLE
	select DYNAMIC_CBMEM
	select ARCH_BOOTBLOCK_ARM_V7
	select ARCH_ROMSTAGE_ARM_V7
	select ARCH_RAMSTAGE_ARM_V7
	bool
	default n

if CPU_SAMSUNG_EXYNOS5250

choice CONSOLE_SERIAL_UART_CHOICES
	prompt "Serial Console UART"
	default CONSOLE_SERIAL_UART3
	depends on CONSOLE_SERIAL_UART

config CONSOLE_SERIAL_UART0
	bool "UART0"
	help
	  Serial console on UART0

config CONSOLE_SERIAL_UART1
	bool "UART1"
	help
	  Serial console on UART1

config CONSOLE_SERIAL_UART2
	bool "UART2"
	help
	  Serial console on UART2

config CONSOLE_SERIAL_UART3
	bool "UART3"
	help
	  Serial console on UART3

endchoice

config CONSOLE_SERIAL_UART_ADDRESS
	hex
	depends on CONSOLE_SERIAL_UART
	default 0x12c00000 if CONSOLE_SERIAL_UART0
	default 0x12c10000 if CONSOLE_SERIAL_UART1
	default 0x12c20000 if CONSOLE_SERIAL_UART2
	default 0x12c30000 if CONSOLE_SERIAL_UART3
	help
	  Map the UART names to the respective MMIO address.

endif
```

## src/soc/samsung/exynos5420/Kconfig
```kconfig
config CPU_SAMSUNG_EXYNOS5420
	select CPU_HAS_BOOTBLOCK_INIT
	select HAVE_MONOTONIC_TIMER
	select GENERIC_UDELAY
	select HAVE_UART_SPECIAL
	select EARLY_CONSOLE
	select RELOCATABLE_MODULES
	select DYNAMIC_CBMEM
	select ARCH_BOOTBLOCK_ARM_V7
	select ARCH_ROMSTAGE_ARM_V7
	select ARCH_RAMSTAGE_ARM_V7
	bool
	default n

if CPU_SAMSUNG_EXYNOS5420

# ROM image layout.
#
# 0x0000: vendor-provided BL1 (8k).
# 0x2000: variable length bootblock checksum header
# 0x2010: bootblock
#  0x9F80-0xA000: reserved for CBFS master header.
# 0xA000: Free for CBFS data.

config BOOTBLOCK_ROM_OFFSET
	hex
	default 0

config CBFS_HEADER_ROM_OFFSET
	hex "offset of master CBFS header in ROM"
	default 0x9F80

config CBFS_ROM_OFFSET
	# Calculated by BOOTBLOCK_ROM_OFFSET + max bootblock size.
	hex "offset of CBFS data in ROM"
	default 0x0A000

choice CONSOLE_SERIAL_UART_CHOICES
	prompt "Serial Console UART"
	default CONSOLE_SERIAL_UART3
	depends on CONSOLE_SERIAL_UART

config CONSOLE_SERIAL_UART0
	bool "UART0"
	help
	  Serial console on UART0

config CONSOLE_SERIAL_UART1
	bool "UART1"
	help
	  Serial console on UART1

config CONSOLE_SERIAL_UART2
	bool "UART2"
	help
	  Serial console on UART2

config CONSOLE_SERIAL_UART3
	bool "UART3"
	help
	  Serial console on UART3

endchoice

config CONSOLE_SERIAL_UART_ADDRESS
	hex
	depends on CONSOLE_SERIAL_UART
	default 0x12c00000 if CONSOLE_SERIAL_UART0
	default 0x12c10000 if CONSOLE_SERIAL_UART1
	default 0x12c20000 if CONSOLE_SERIAL_UART2
	default 0x12c30000 if CONSOLE_SERIAL_UART3
	help
	  Map the UART names to the respective MMIO address.

endif
```
