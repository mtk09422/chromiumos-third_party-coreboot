## src/mainboard/intel/bayleybay/Kconfig
```kconfig
if BOARD_INTEL_BAYLEYBAY

config BOARD_SPECIFIC_OPTIONS
	def_bool y
	select SOC_INTEL_BAYTRAIL
	select ENABLE_BUILTIN_COM1
	select BOARD_ROMSIZE_KB_8192
	select HAVE_ACPI_TABLES
	select HAVE_OPTION_TABLE
	select HAVE_ACPI_RESUME
	select CHROMEOS
	select CHROMEOS_VBNV_CMOS

config MAINBOARD_DIR
	string
	default intel/bayleybay

config MAINBOARD_PART_NUMBER
	string
	default "BAYLEY BAY"

config VGA_BIOS_FILE
	string
	default "pci8086,0166.rom"

endif # BOARD_INTEL_BAYLEYBAY
```

## src/mainboard/intel/glados/Kconfig
```kconfig
if BOARD_INTEL_GLADOS

config BOARD_SPECIFIC_OPTIONS # dummy
	def_bool y
	select BOARD_ROMSIZE_KB_16384
	select SOC_INTEL_SKYLAKE

config DESC_FILE
string
	default "descriptor-rvp3.bin"

config MAINBOARD_DIR
	string
	default intel/glados

config MAINBOARD_PART_NUMBER
	string
	default "Glados"

config VGA_BIOS_FILE
	string
	default "pci8086,0166.rom"

endif
```

## src/mainboard/intel/pearlvalley/Kconfig
```kconfig
if BOARD_INTEL_PEARLVALLEY

config BOARD_SPECIFIC_OPTIONS # dummy
	def_bool y
	select SOC_INTEL_BROADWELL
	select BOARD_ROMSIZE_KB_8192
	select HAVE_ACPI_TABLES
	select HAVE_OPTION_TABLE
	select HAVE_ACPI_RESUME
	select MMCONF_SUPPORT
	select HAVE_SMI_HANDLER
	select CHROMEOS
	select CHROMEOS_VBNV_CMOS
	select EXTERNAL_MRC_BLOB
	select CACHE_ROM
	select MARK_GRAPHICS_MEM_WRCOMB
	select MONOTONIC_TIMER_MSR
	select CHROMEOS_RAMOOPS_DYNAMIC

config VBOOT_RAMSTAGE_INDEX
	hex
	default 0x1

config VBOOT_REFCODE_INDEX
	hex
	default 0x2

config MAINBOARD_DIR
	string
	default intel/pearlvalley

config MAINBOARD_PART_NUMBER
	string
	default "Pearl Valley CRB"

config IRQ_SLOT_COUNT
	int
	default 18

config MAX_CPUS
	int
	default 16

config VGA_BIOS_FILE
	string
	default "pci8086,0166.rom"

endif
```

## src/mainboard/intel/sklrvp/Kconfig
```kconfig
if BOARD_INTEL_SKLRVP

config BOARD_SPECIFIC_OPTIONS # dummy
	def_bool y
	select BOARD_ROMSIZE_KB_16384
	select CHROMEOS
	select CHROMEOS_RAMOOPS_DYNAMIC
	select CHROMEOS_VBNV_CMOS
	select SOC_INTEL_SKYLAKE

config MAINBOARD_DIR
	string
	default "intel/sklrvp"

config MAINBOARD_PART_NUMBER
	string
	default "Skylake RVP"

config VBOOT_RAMSTAGE_INDEX
	hex
	default 0x3

endif
```

## src/mainboard/intel/strago/Kconfig
```kconfig
if BOARD_INTEL_STRAGO

config BOARD_SPECIFIC_OPTIONS
	def_bool y
	select SOC_INTEL_BRASWELL
	select ENABLE_BUILTIN_COM1
	select BOARD_ROMSIZE_KB_8192
	select CHROMEOS

config MAINBOARD_DIR
	string
	default intel/strago

config MAINBOARD_PART_NUMBER
	string
	default "Strago"

config VGA_BIOS_FILE
	string
	default "pci8086,22B0.rom"

endif # BOARD_INTEL_STRAGO
```

## src/soc/Kconfig
```kconfig
source src/soc/broadcom/Kconfig
source src/soc/imgtec/Kconfig
source src/soc/intel/Kconfig
source src/soc/marvell/Kconfig
source src/soc/nvidia/Kconfig
source src/soc/qualcomm/Kconfig
source src/soc/samsung/Kconfig
source src/soc/rockchip/Kconfig
```

## src/soc/intel/Kconfig
```kconfig
source src/soc/intel/baytrail/Kconfig
source src/soc/intel/braswell/Kconfig
source src/soc/intel/broadwell/Kconfig
source src/soc/intel/common/Kconfig
source src/soc/intel/skylake/Kconfig
```

## src/soc/intel/braswell/Kconfig
```kconfig
config SOC_INTEL_BRASWELL
	bool
	help
	  Braswell M/D part support.

if SOC_INTEL_BRASWELL

config CPU_SPECIFIC_OPTIONS
	def_bool y
	select ARCH_BOOTBLOCK_X86_32
	select ARCH_ROMSTAGE_X86_32
	select ARCH_RAMSTAGE_X86_32
	select ALT_CBFS_LOAD_PAYLOAD
	select CACHE_RELOCATED_RAMSTAGE_OUTSIDE_CBMEM
	select CACHE_ROM
	select CAR_MIGRATION
	select COLLECT_TIMESTAMPS
	select CPU_MICROCODE_IN_CBFS
	select CPU_INTEL_TURBO_NOT_PACKAGE_SCOPED
	select DYNAMIC_CBMEM
	select HAS_PRECBMEM_TIMESTAMP_REGION
	select HAVE_MONOTONIC_TIMER
	select HAVE_HARD_RESET
	select MMCONF_SUPPORT
	select MMCONF_SUPPORT_DEFAULT
	select RELOCATABLE_MODULES
	select PARALLEL_MP
	select PCIEXP_ASPM
	select PCIEXP_COMMON_CLOCK
	select SMM_MODULES
	select SSE2
	select TSC_CONSTANT_RATE
	select TSC_MONOTONIC_TIMER
	select TSC_SYNC_MFENCE
	select UDELAY_TSC

config BOOTBLOCK_CPU_INIT
	string
	default "soc/intel/braswell/bootblock/bootblock.c"

config MMCONF_BASE_ADDRESS
	hex "PCIe CFG Base Address"
	default 0xe0000000

config MAX_CPUS
	int
	default 4

# Cache As RAM region layout:
#
# +-------------+ DCACHE_RAM_BASE + DCACHE_RAM_SIZE
# |  Stack      |\
# |    |        | * DCACHE_RAM_ROMSTAGE_STACK_SIZE
# |    v        |/
# +-------------+
# |    ^        |
# |    |        |
# | CAR Globals |
# +-------------+ DCACHE_RAM_BASE
#

config DCACHE_RAM_BASE
	hex "Temporary RAM Base Address"
	default 0xfef00000

config DCACHE_RAM_SIZE
	hex "Temporary RAM Size"
	default 0x4000
	help
	  The size of the cache-as-ram region required during bootblock
	  and/or romstage. Note DCACHE_RAM_SIZE and DCACHE_RAM_MRC_VAR_SIZE
	  must add up to a power of 2.

config DCACHE_RAM_ROMSTAGE_STACK_SIZE
	hex
	default 0x800
	help
	  The amount of anticipated stack usage from the data cache
	  during pre-ram rom stage execution.

config CBFS_SIZE
	hex "Size of CBFS filesystem in ROM"
	default 0x100000
	help
	  The firmware image has to store a lot more than just coreboot,
	  including:
	   - a firmware descriptor
	   - Intel Management Engine firmware
	   - MRC cache information
	  This option allows to limit the size of the CBFS portion in the
	  firmware image.

config ENABLE_BUILTIN_COM1
	bool "Enable builtin COM1 Serial Port"
	default n
	help
	  The PMC has a legacy COM1 serial port. Choose this option to
	  configure the pads and enable it. This serial port can be used for
	  the debug console.

endif
```

## src/soc/intel/common/Kconfig
```kconfig
if HAVE_MRC

config CACHE_MRC_SETTINGS
	bool "Save cached MRC settings"
	default n
	help
	  If CONFIG_USE_FMAP is enabled, it is assumed that a flashmap
	  containing an RW_MRC_CACHE entry that specifies the location and size
	  of the cache will be added to the image and present at runtime.

if CACHE_MRC_SETTINGS

config MRC_SETTINGS_CACHE_BASE
	hex
	depends on !USE_FMAP
	default 0xffb00000

config MRC_SETTINGS_CACHE_SIZE
	hex
	depends on !USE_FMAP
	default 0x10000

config MRC_SETTINGS_PROTECT
	bool "Enable protection on MRC settings"
	depends on !USE_FMAP
	default n

endif # CACHE_MRC_SETTINGS

endif # HAVE_MRC

config COMMON_STACK
	bool
	default n

config COMMON_RAM_INIT
	bool "FSP: Use the common raminit.c module"
	default n
	depends on PLATFORM_USES_FSP

config COMMON_RESET
	bool
	default n

config COMMON_ROMSTAGE
	bool
	default n

config ROMSTAGE_RAM_STACK_SIZE
	hex "Size of the romstage RAM stack in bytes"
	default 0x5000

config COMMON_SPI_LOADING
	bool "Use the common spi_loading.c module"
	default n
	depends on ALT_CBFS_LOAD_PAYLOAD
```

## src/soc/intel/skylake/Kconfig
```kconfig
config SOC_INTEL_SKYLAKE
	bool
	help
	  Intel Skylake support.

if SOC_INTEL_SKYLAKE

config CPU_SPECIFIC_OPTIONS
	def_bool y
	select ARCH_BOOTBLOCK_X86_32
	select ARCH_ROMSTAGE_X86_32
	select ARCH_RAMSTAGE_X86_32
	select CACHE_RELOCATED_RAMSTAGE_OUTSIDE_CBMEM
	select CACHE_ROM
	select CAR_MIGRATION
	select COMMON_RESET
	select COMMON_ROMSTAGE
	select COLLECT_TIMESTAMPS
	select CPU_MICROCODE_IN_CBFS
	select DYNAMIC_CBMEM
	select HAS_PRECBMEM_TIMESTAMP_REGION
	select HAVE_HARD_RESET
	select HAVE_MONOTONIC_TIMER
	select MMCONF_SUPPORT
	select MMCONF_SUPPORT_DEFAULT
	select PCIEXP_ASPM
	select PCIEXP_COMMON_CLOCK
	select PCIEXP_CLK_PM
	select PCIEXP_L1_SUB_STATE
	select RELOCATABLE_MODULES
	select TSC_CONSTANT_RATE
	select TSC_MONOTONIC_TIMER
	select TSC_SYNC_MFENCE
	select UDELAY_TSC

config BOOTBLOCK_CPU_INIT
	string
	default "soc/intel/skylake/bootblock/cpu.c"

config BOOTBLOCK_NORTHBRIDGE_INIT
	string
	default "soc/intel/skylake/bootblock/systemagent.c"

config BOOTBLOCK_RESETS
	string
	default "soc/intel/common/reset.c"

config BOOTBLOCK_SOUTHBRIDGE_INIT
	string
	default "soc/intel/skylake/bootblock/pch.c"

config CBFS_SIZE
	hex "Size of CBFS filesystem in ROM"
	default 0x100000
	help
	  The firmware image has to store more than just coreboot, including:
	   - a firmware descriptor
	   - Intel Management Engine firmware
	   - MRC cache information
	  This option allows to limit the size of the CBFS portion in the
	  firmware image.

config DCACHE_RAM_BASE
	hex "Base address of cache-as-RAM"
	default 0xff7c0000

config DCACHE_RAM_SIZE
	hex "Length in bytes of cache-as-RAM"
	default 0x10000
	help
	  The size of the cache-as-ram region required during bootblock
	  and/or romstage.

config EXTRA_MICROCODE_INCLUDE_PATH
	string "Include path for extra microcode patches."
	help
	  The path to any extra microcode patches from other sources.

config IED_REGION_SIZE
	hex
	default 0x400000

config MICROCODE_INCLUDE_PATH
	string
	default "src/soc/intel/skylake/microcode"

config MMCONF_BASE_ADDRESS
	hex "MMIO Base Address"
	default 0xe0000000

config SERIAL_CPU_INIT
	bool
	default n

config TTYS0_BASE
	hex
	default 0xd6000000
	depends on INTEL_PCH_UART_CONSOLE

endif
```

## src/soc/mediatek/mt8135/Kconfig
```kconfig
config SOC_MEDIATEK_MT8135
	bool
	default n
	select ARM_BOOTBLOCK_CUSTOM
	select ARCH_BOOTBLOCK_ARM_V7
	select ARCH_RAMSTAGE_ARM_V7
	select ARCH_ROMSTAGE_ARM_V7
	select BOOTBLOCK_CONSOLE
	select DYNAMIC_CBMEM
	select EARLY_CONSOLE
	select HAVE_UART_MEMORY_MAPPED
	select HAVE_UART_SPECIAL
	select SPI_ATOMIC_SEQUENCING
	select HAVE_MONOTONIC_TIMER
	select HAVE_INIT_TIMER
	select HAS_PRECBMEM_TIMESTAMP_REGION
	select DEBUG_CBFS
#	select DEBUG_SOC_DRIVER

if SOC_MEDIATEK_MT8135

# ROM Image Layout
# 0x0000 0000    Combined Bootblock, DH and GFH headers
# 0x0001 8000    CBFS Header
# 0x0001 8080    CBFS Data (Romstage, Ramstage, Depthcharge)

# SRAM Layout
# 0x0010_0000    TTB (16K+32B). 32B is for L1 table of LPAE.
# 0x0010_4020    CBMEM console area (8K-32B) See confing.llama CONFIG_CONSOLE_PRERAM_BUFFER_SIZE=0x1fe0
# 0x0010_6000    STACK (16KB) (0x4000)
# 0x0010_A000    CBFS Cache 64K (0x10000)
# 0x0011_A000    ROMSTAGE 88K (0x16000)

# 0x1200_0000    - Is it in use? 4K (0x1000)
# 0x1200_1000    BOOTBLOCK 48K (0xB000)
#                !!! Try to reuse BOOTBLOCK area for TTB_BUFFER !!!

config DEBUG_SOC_DRIVER
	bool "The top level switch for soc driver debug message"
	default n
#	select DEBUG_CBFS_EMMC
#	select DEBUG_MEMORY_DRAM
#	select DEBUG_I2C
#	select DEBUG_KEY
#	select DEBUG_MMC
#	select DEBUG_MSDC
#	select DEBUG_PMIC
#	select DEBUG_PMIC_WRAP

config DEBUG_CBFS_EMMC
	bool "Output verbose EMMC CBFS debug messages"
	default n
	help
	  This option enables additional EMMC CBFS related debug messages.

config DEBUG_MEMORY_DRAM
	bool "Output verbose DRAM related debug message"
	default n
	help
	  This option enables additional DRAM related debug messages.

config DEBUG_I2C
	bool "Output verbose I2C related debug message"
	default n
	help
	  This option enables I2C related debug message.

config DEBUG_KEY
	bool "Output verbose key related debug message"
	default n
	help
	  This option enables key related debug message.

config DEBUG_MMC
	bool "Output verbose eMMC related debug message"
	default n
	help
	  This option enables eMMC related debug message.

config DEBUG_MSDC
	bool "Output verbose MSDC related debug message"
	default n
	help
	  This option enables MSDC related debug message.

config DEBUG_PMIC
	bool "Output verbose PMIC related debug message"
	default n
	help
	  This option enables PMIC related debug message.

config DEBUG_PMIC_WRAP
	bool "Output verbose PMIC WRAP related debug message"
	default n
	help
	  This option enables PMIC WRAP related debug message.
endif
```

## src/soc/mediatek/mt8173/Kconfig
```kconfig
config SOC_MEDIATEK_MT8173
	bool
	default n
	select ARM64_BOOTBLOCK_CUSTOM
	select ARCH_BOOTBLOCK_ARM_V8_64
	select ARCH_RAMSTAGE_ARM_V8_64
	select ARCH_ROMSTAGE_ARM_V8_64
	select ARCH_VERSTAGE_ARM_V8_64
	select BOOTBLOCK_CONSOLE
	select DYNAMIC_CBMEM
	select EARLY_CONSOLE
	select HAVE_UART_MEMORY_MAPPED
	select HAVE_UART_SPECIAL
	select SPI_ATOMIC_SEQUENCING
	select HAVE_MONOTONIC_TIMER
	select GENERIC_UDELAY
	select HAVE_INIT_TIMER
	select HAS_PRECBMEM_TIMESTAMP_REGION
	select MEDIATEK_DISPLAY_INIT
	select DEBUG_CBFS
	select HAVE_USB_HUB_HX3
	select HAVE_USB_HUB_RTS5411
	select HAVE_HARD_RESET

if SOC_MEDIATEK_MT8173

config MEDIATEK_DISPLAY_INIT
	bool "initial mediatek display port"
	default n

config HAVE_USB_HUB_HX3
	bool "Initial external Cypress USB Hub HX3"
	default n
	help
	  Initial & config the Cypress USB Hub HX3 via I2C bus

config HAVE_USB_HUB_RTS5411
	bool "Initial external Realtek USB Hub RTS5411"
	default n
	help
	  Initial & config the Realtek USB Hub RTS5411 via I2C bus

config DEBUG_SOC_DRIVER
	bool "The top level switch for soc driver debug message"
	default n
	select DEBUG_MEMORY_DRAM
	select DEBUG_I2C
	select DEBUG_KEY
	select DEBUG_PMIC
	select DEBUG_PMIC_WRAP

config DEBUG_MEMORY_DRAM
	bool "Output verbose DRAM related debug message"
	default n
	help
	  This option enables additional DRAM related debug messages.

config DEBUG_I2C
	bool "Output verbose I2C related debug message"
	default n
	help
	  This option enables I2C related debug message.

config DEBUG_KEY
	bool "Output verbose key related debug message"
	default n
	help
	  This option enables key related debug message.

config DEBUG_PMIC
	bool "Output verbose PMIC related debug message"
	default n
	help
	  This option enables PMIC related debug message.

config DEBUG_PMIC_WRAP
	bool "Output verbose PMIC WRAP related debug message"
	default n
	help
	  This option enables PMIC WRAP related debug message.
endif
```

## src/soc/nvidia/Kconfig
```kconfig
source src/soc/nvidia/tegra124/Kconfig
source src/soc/nvidia/tegra132/Kconfig
source src/soc/nvidia/tegra210/Kconfig
```

## src/soc/nvidia/tegra124/Kconfig
```kconfig
config SOC_NVIDIA_TEGRA124
	bool
	default n
	select HAVE_UART_MEMORY_MAPPED
	select HAVE_UART_SPECIAL
	select HAVE_HARD_RESET
	select HAVE_MONOTONIC_TIMER
	select GENERIC_UDELAY
	select BOOTBLOCK_CONSOLE
	select EARLY_CONSOLE
	select DYNAMIC_CBMEM
	select ARM_BOOTBLOCK_CUSTOM
	select ARCH_BOOTBLOCK_ARM_V4
	select ARCH_VERSTAGE_ARM_V7
	select ARCH_ROMSTAGE_ARM_V7
	select ARCH_RAMSTAGE_ARM_V7
	select ARM_LPAE
	select COLLECT_TIMESTAMPS
	select HAS_PRECBMEM_TIMESTAMP_REGION

if SOC_NVIDIA_TEGRA124

config BOOTBLOCK_CPU_INIT
	string
	default "soc/nvidia/tegra124/bootblock.c"
	help
	  CPU/SoC-specific bootblock code. This is useful if the
	  bootblock must load microcode or copy data from ROM before
	  searching for the bootblock.

choice CONSOLE_SERIAL_TEGRA124_UART_CHOICES
	prompt "Serial Console UART"
	default CONSOLE_SERIAL_UARTA
	depends on CONSOLE_SERIAL_UART

config CONSOLE_SERIAL_UARTA
	bool "UARTA"
	help
	  Serial console on UART A.

config CONSOLE_SERIAL_UARTB
	bool "UARTB"
	help
	  Serial console on UART B.

config CONSOLE_SERIAL_UARTC
	bool "UARTC"
	help
	  Serial console on UART C.

config CONSOLE_SERIAL_UARTD
	bool "UARTD"
	help
	  Serial console on UART D.

config CONSOLE_SERIAL_UARTE
	bool "UARTE"
	help
	  Serial console on UART E.

endchoice

config CONSOLE_SERIAL_UART_ADDRESS
	hex
	depends on CONSOLE_SERIAL_UART
	default 0x70006000 if CONSOLE_SERIAL_UARTA
	default 0x70006040 if CONSOLE_SERIAL_UARTB
	default 0x70006200 if CONSOLE_SERIAL_UARTC
	default 0x70006300 if CONSOLE_SERIAL_UARTD
	default 0x70006400 if CONSOLE_SERIAL_UARTE
	help
	  Map the UART names to the respective MMIO addres.

config TEGRA124_MODEL_TD570D
	bool "TD570D"

config TEGRA124_MODEL_TD580D
	bool "TD580D"

config TEGRA124_MODEL_CD570M
	bool "CD570M"

config TEGRA124_MODEL_CD580M
	bool "CD580M"

# Default to 2GHz, the lowest maximum frequency.
config PLLX_KHZ
	int
	default 2000000 if TEGRA124_MODEL_TD570D
	default 2300000 if TEGRA124_MODEL_TD580D
	default 2100000 if TEGRA124_MODEL_CD570M
	default 2300000 if TEGRA124_MODEL_CD580M
	default 2000000

endif
```
